## boards/arm/cannode/Kconfig.board
```kconfig
# Kconfig - CAN Node board configuration
#
# Copyright (c) 2018 Josef Raschen
#
# SPDX-License-Identifier: Apache-2.0
#

config BOARD_CANNODE
	bool "CAN Node Board"
	depends on SOC_STM32F072XB
```

## boards/arm/cannode/Kconfig.defconfig
```kconfig
# Kconfig - CAN Node board configuration
#
# Copyright (c) 2018 Josef Raschen
#
# SPDX-License-Identifier: Apache-2.0
#

if BOARD_CANNODE

config BOARD
	default "cannode"

if UART_CONSOLE

config UART_STM32_PORT_1
	default y

endif # UART_CONSOLE

endif # BOARD_CANNODE
```

## boards/arm/cannode/cannode_defconfig
```kconfig
# Zephyr Kernel Configuration
CONFIG_ARM=y
CONFIG_SOC_SERIES_STM32F0X=y

# Platform Configuration
CONFIG_SOC_FAMILY_STM32=y
CONFIG_SOC_STM32F072XB=y
CONFIG_BOARD_CANNODE=y

# General Kernel Options
CONFIG_CORTEX_M_SYSTICK=y
CONFIG_SYS_CLOCK_HW_CYCLES_PER_SEC=8000000

# Serial Drivers
CONFIG_SERIAL=y
CONFIG_UART_INTERRUPT_DRIVEN=y
# enable console
CONFIG_CONSOLE=y
CONFIG_UART_CONSOLE=y

# Pinmux Driver
CONFIG_PINMUX=y

# GPIO Controller
CONFIG_GPIO=y

# Clock configuration
CONFIG_CLOCK_CONTROL=y
CONFIG_CLOCK_STM32_SYSCLK_SRC_HSI=y
CONFIG_CLOCK_STM32_PLL_SRC_HSI=y
CONFIG_CLOCK_STM32_PLL_PREDIV1=1
CONFIG_CLOCK_STM32_AHB_PRESCALER=1
CONFIG_CLOCK_STM32_APB1_PRESCALER=1
```

## boards/arm/hvac_sensors/Kconfig.board
```kconfig
# Kconfig - HVAC Sensors board configuration
#
# Copyright (c) 2018 Josef Raschen
#
# SPDX-License-Identifier: Apache-2.0
#

config BOARD_HVAC_SENSORS
	bool "HVAC Sensors Board"
	depends on SOC_STM32F072XB
```

## boards/arm/hvac_sensors/Kconfig.defconfig
```kconfig
# Kconfig - HVAC Sensors Board configuration
#
# Copyright (c) 2019 Josef Raschen
#
# SPDX-License-Identifier: Apache-2.0
#

if BOARD_HVAC_SENSORS

config BOARD
	default "hvac_sensors"

if UART_CONSOLE

config UART_1
	default y

endif # UART_CONSOLE

if I2C

config I2C_2
    default y

endif # I2C

endif # BOARD_HVAC_SENSORS
```

## drivers/sensor/hdc1080/Kconfig
```kconfig
# Kconfig - HDC1080 temperature and humidity sensor configuration options

#
# Copyright (c) 2016 Intel Corporation
#
# SPDX-License-Identifier: Apache-2.0
#

menuconfig HDC1080
	bool "HDC1080 Temperature and Humidity Sensor"
	depends on I2C
	help
	  Enable driver for HDC1080 temperature and humidity sensors.
```
